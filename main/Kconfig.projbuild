## main/Kconfig.projbuild
```kconfig
menu "HeartBox Configuration"

    config HEARTBOX_DEVICE_NAME
        string "Device Name"
        default "Heart_Box_1"
        help
            The name of the device. Used to identify the device in AWS IoT and to locate certificate files.

    config HEARTBOX_TOPIC_NAME
        string "MQTT Topic Name"
        default "heartbox/1"
        help
            The MQTT topic name used for publishing and subscribing.

    config HEARTBOX_LOG_TOPIC_NAME
        string "MQTT Log Topic Name"
        default "heartbox/${HEARTBOX_DEVICE_NAME}/log"
        help
            The MQTT topic name used for publishing and subscribing.

    config HEARTBOX_AWS_IOT_ENDPOINT
        string "AWS IoT Endpoint"
        default "airgahux2exxu-ats.iot.us-east-1.amazonaws.com"
        help
            The AWS IoT endpoint URL for this device to connect to.

    config HEARTBOX_TEST_WIFI_SSID
        string "Test WiFi SSID"
        default "OctopusChurch"
        help
            WiFi SSID to use for testing.

    config HEARTBOX_TEST_WIFI_PASSWORD
        string "Test WiFi Password"
        default "BishopNemo"
        help
            WiFi password to use for testing.

endmenu
```

## sdkconfig.defaults
```kconfig
# HeartBox Configuration
CONFIG_HEARTBOX_DEVICE_NAME="Test"
CONFIG_HEARTBOX_TOPIC_NAME=""
CONFIG_HEARTBOX_AWS_IOT_ENDPOINT=""

CONFIG_HEARTBOX_TEST_WIFI_SSID = ""
CONFIG_HEARTBOX_TEST_WIFI_PASSWORD = ""
```
